## config/boards/shields/fish/Kconfig.defconfig
```kconfig
# Copyright (c) 2021 The ZMK Contributors
# SPDX-License-Identifier: MIT


# 親機にしたい方を読ませる
if SHIELD_FISH_LEFT
# if SHIELD_FISH_RIGHT

config ZMK_SPLIT_ROLE_CENTRAL
    default y
endif


if SHIELD_FISH_LEFT || SHIELD_FISH_RIGHT

config ZMK_SPLIT
    default y
endif
```

## config/boards/shields/fish/Kconfig.shield
```kconfig
# Copyright (c) 2021 The ZMK Contributors
# SPDX-License-Identifier: MIT

# このファイルをいじる必要はない

config SHIELD_FISH_LEFT
    def_bool $(shields_list_contains,fish_left)

config SHIELD_FISH_RIGHT
    def_bool $(shields_list_contains,fish_right)
```
